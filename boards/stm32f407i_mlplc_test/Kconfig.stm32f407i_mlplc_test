## boards/stm32f407i_mlplc_test/Kconfig.stm32f407i_mlplc_test
```kconfig
# Copyright (c) 2016 Linaro Limited.
# SPDX-License-Identifier: Apache-2.0

config BOARD_STM32F407I_MLPLC_TEST
	select SOC_STM32F407XG
```

## boards/stm32f407i_mlplc_test/board.yml
```yaml
board:
  name: stm32f407i_mlplc_test
  full_name: STM32F4 Discovery
  vendor: st
  socs:
    - name: stm32f407xx
```

## examples/test/sample.yaml
```yaml
sample:
  name: MLPLC test firmware
tests:
  examples.test:
    tags:
      - full
    filter: dt_enabled_alias_with_parent_compat("led0", "gpio-leds")
    depends_on: gpio
    harness: led
    integration_platforms:
      - frdm_k64f
```
